 /****************************************************************************
*
*   Copyright (c) 2012, BeiJing EFLAG Technology Co., LTD.
*   All rights reserved.
*
*   文件名称 ：stm32f2xx_it.c
*   摘 要    ： 
*
*   当前版本 ： 
*   作 者    ： EFLAG
*   完成日期 ： 
*
*   取代版本 ：
*   原作者   ： 
*   修改内容 ：
*   完成日期 ：2012.08.01 
*
******************************************************************************/

/*************头文件**********************************************************/
#include "stm32f2xx_it.h"
#include "stm32_eval.h"

/******************************************************************************/
/*            Cortex-M3 处理器异常处理程序                         */
/******************************************************************************/

/****************************************************************************
* 函数名: NMI_Handler()
* 功 能: 该函数可以处理屏敝中断异常
* 输 入: 无
* 输 出: 无
****************************************************************************/
void NMI_Handler(void)
{
  /* HSE时钟复位失败时产生该中断 */

  if (RCC_GetITStatus(RCC_IT_CSS) != RESET)
  {
    /* 在此期间: HSE,PLL被使能(但是没有改变PLL的配置)并且HSI
       被选择为系统时钟 */

    /* 使能HSE */
    RCC_HSEConfig(RCC_HSE_ON);

    /* 使能HSE Ready and PLL Ready interrupts */
    RCC_ITConfig(RCC_IT_HSERDY | RCC_IT_PLLRDY, ENABLE);

    /* 清除安全时钟中断挂起位 */
    RCC_ClearITPendingBit(RCC_IT_CSS);

    /* 一旦HSE时钟恢复, 这个HSERDY interrupt is generated and in the RCC ISR
       routine the system clock will be reconfigured to its previous state (before
       HSE clock failure) */
  }
}

/****************************************************************************
* 函数名: HardFault_Handler()
* 功 能: 该函数可以处理硬件异常
* 输 入: 无
* 输 出: 无
****************************************************************************/
void HardFault_Handler(void)
{
  /* 硬件异常发生时进入无限循环 */
  while (1)
  {
  }
}

/****************************************************************************
* 函数名: MemManage_Handler()
* 功 能: 该函数可以处理内存管理异常
* 输 入: 无
* 输 出: 无
****************************************************************************/
void MemManage_Handler(void)
{
  /* 内存管理异常发生时进入无限循环 */
  while (1)
  {
  }
}

/****************************************************************************
* 函数名: BusFault_Handler()
* 功 能: 该函数可以处理总线错误异常
* 输 入: 无
* 输 出: 无
****************************************************************************/
void BusFault_Handler(void)
{
  /* 总线错误异常发生时进入无限循环 */
  while (1)
  {
  }
}

/****************************************************************************
* 函数名: UsageFault_Handler()
* 功 能: 该函数可以处理非法使用异常
* 输 入: 无
* 输 出: 无
****************************************************************************/
void UsageFault_Handler(void)
{
  /* 非法使用异常发生时进入无限循环 */
  while (1)
  {
  }
}

/****************************************************************************
* 函数名: SVC_Handler()
* 功 能: 该函数可以处理不安全访问异常
* 输 入: 无
* 输 出: 无
****************************************************************************/
void SVC_Handler(void)
{
}

/****************************************************************************
* 函数名: DebugMon_Handler()
* 功 能: 该函数可以处理调试监视器异常
* 输 入: 无
* 输 出: 无
****************************************************************************/
void DebugMon_Handler(void)
{
}

/****************************************************************************
* 函数名: PendSV_Handler()
* 功 能: 该函数可以处理交换虚拟电路挂起异常
* 输 入: 无
* 输 出: 无
****************************************************************************/
void PendSV_Handler(void)
{
}

/****************************************************************************
* 函数名: SysTick_Handler()
* 功 能: 该函数可以处理系统时钟
* 输 入: 无
* 输 出: 无
****************************************************************************/
void SysTick_Handler(void)
{
}

/******************************************************************************/
/*                 STM32F2xx外围设备的中断处理程序                            */
/*  在这里添加外围中断处理程序                                                */
/*  可用的外围中断处理程序的操作名称请参阅启动文件startup_stm32f2xx.s         */
/******************************************************************************/

/****************************************************************************
* 函数名: RCC_IRQHandler()
* 功 能: 该函数可以处理RCC中断请求
* 输 入: 无
* 输 出: 无
****************************************************************************/
void RCC_IRQHandler(void)
{
  if(RCC_GetITStatus(RCC_IT_HSERDY) != RESET)
  { 
    /* 清除HSERDY中断标志位 */
    RCC_ClearITPendingBit(RCC_IT_HSERDY);

    /* 检查HSE时钟仍然可用 */
    if (RCC_GetFlagStatus(RCC_FLAG_HSERDY) != RESET)
    { 
      /* 启用PLL:一旦PLL就绪PLLRDY产生中断 */ 
      RCC_PLLCmd(ENABLE);     
    }
  }

  if(RCC_GetITStatus(RCC_IT_PLLRDY) != RESET)
  { 
    /* 清除PLLRDY中断标志位 */
    RCC_ClearITPendingBit(RCC_IT_PLLRDY);

    /* 检查锁相环PLL是否为锁 */
    if (RCC_GetFlagStatus(RCC_FLAG_PLLRDY) != RESET)
    { 
      /* 选择PLL作为时钟源 */
      RCC_SYSCLKConfig(RCC_SYSCLKSource_PLLCLK);
    }
  }
}

/****** (C) 版权2012北京亿旗创新科技发展有限公司 ******文档结束*************/
