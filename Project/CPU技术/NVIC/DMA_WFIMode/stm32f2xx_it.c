 /****************************************************************************
*
*   Copyright (c) 2012, BeiJing EFLAG Technology Co., LTD.
*   All rights reserved.
*
*   文件名称 ：stm32f2xx_it.c
*   摘 要    ： 
*
*   当前版本 ： 
*   作 者    ： EFLAG
*   完成日期 ： 
*
*   取代版本 ：
*   原作者   ： 
*   修改内容 ：
*   完成日期 ：2012.08.01 
*
******************************************************************************/

/*************头文件**********************************************************/
#include "stm32f2xx_it.h"
#include "stm32_eval.h"

/* 重定义 -------------------------------------------------------------------*/
/* 自定义 -------------------------------------------------------------------*/
/* 私有宏定义 ---------------------------------------------------------------*/
/* 私有变量 -----------------------------------------------------------------*/
uint8_t TestStatus = 0;
uint16_t SrcBuffer[10] = {0x30, 0x31, 0x32, 0x33, 0x34, 0x35, 0x36, 0x37, 0x38, 0x39};
extern uint16_t DstBuffer[10];
extern __IO uint32_t LowPowerMode;
extern uint8_t Buffercmp16(uint16_t*, uint16_t*, uint16_t);

/******************************************************************************/
/*            Cortex-M3 处理器异常处理程序                         */
/******************************************************************************/

/****************************************************************************
* 函数名: NMI_Handler()
* 功 能: 该函数可以处理屏敝中断异常
* 输 入: 无
* 输 出: 无
****************************************************************************/
void NMI_Handler(void)
{
}

/****************************************************************************
* 函数名: HardFault_Handler()
* 功 能: 该函数可以处理硬件异常
* 输 入: 无
* 输 出: 无
****************************************************************************/
void HardFault_Handler(void)
{
  /* 硬件异常发生时进入无限循环 */
  while (1)
  {
  }
}

/****************************************************************************
* 函数名: MemManage_Handler()
* 功 能: 该函数可以处理内存管理异常
* 输 入: 无
* 输 出: 无
****************************************************************************/
void MemManage_Handler(void)
{
  /* 内存管理异常发生时进入无限循环 */
  while (1)
  {
  }
}

/****************************************************************************
* 函数名: BusFault_Handler()
* 功 能: 该函数可以处理总线错误异常
* 输 入: 无
* 输 出: 无
****************************************************************************/
void BusFault_Handler(void)
{
  /* 总线错误异常发生时进入无限循环 */
  while (1)
  {
  }
}

/****************************************************************************
* 函数名: UsageFault_Handler()
* 功 能: 该函数可以处理非法使用异常
* 输 入: 无
* 输 出: 无
****************************************************************************/
void UsageFault_Handler(void)
{
  /* 非法使用异常发生时进入无限循环 */
  while (1)
  {
  }
}

/****************************************************************************
* 函数名: SVC_Handler()
* 功 能: 该函数可以处理不安全访问异常
* 输 入: 无
* 输 出: 无
****************************************************************************/
void SVC_Handler(void)
{
}

/****************************************************************************
* 函数名: DebugMon_Handler()
* 功 能: 该函数可以处理调试监视器异常
* 输 入: 无
* 输 出: 无
****************************************************************************/
void DebugMon_Handler(void)
{
}

/****************************************************************************
* 函数名: PendSV_Handler()
* 功 能: 该函数可以处理交换虚拟电路挂起异常
* 输 入: 无
* 输 出: 无
****************************************************************************/
void PendSV_Handler(void)
{
}

/****************************************************************************
* 函数名: SysTick_Handler()
* 功 能: 该函数可以处理系统时钟
* 输 入: 无
* 输 出: 无
****************************************************************************/
void SysTick_Handler(void)
{
}

/******************************************************************************/
/*                 STM32F2xx外围设备的中断处理程序                            */
/*  在这里添加外围中断处理程序                                                */
/*  可用的外围中断处理程序的操作名称请参阅启动文件startup_stm32f2xx.s         */
/******************************************************************************/

/****************************************************************************
* 函数名: DMA2_Stream5_IRQHandler()
* 功 能: 该函数可以处理DMA1 Stream1中断请求
* 输 入: 无
* 输 出: 无
****************************************************************************/
void DMA2_Stream5_IRQHandler(void)
{
  if(DMA_GetITStatus(DMA2_Stream5, DMA_IT_TCIF5))
  {
    DMA_ClearITPendingBit(DMA2_Stream5, DMA_IT_TCIF5);

    /* 检查接收缓冲区 */
    TestStatus = Buffercmp16(SrcBuffer, DstBuffer, 10);

    if(TestStatus == 0)
    {
      STM_EVAL_LEDToggle(LED2);
    }
    else
    {
      STM_EVAL_LEDToggle(LED3);
    }
  }
}

/****************************************************************************
* 函数名: EXTI15_10_IRQHandler()
* 功 能: 该函数可以处理外部行15 - 10中断请求
* 输 入: 无
* 输 出: 无
****************************************************************************/
void EXTI15_10_IRQHandler(void)
{
  if(EXTI_GetITStatus(USER1_BUTTON_EXTI_LINE ) != RESET)
  {
    EXTI_ClearITPendingBit(USER1_BUTTON_EXTI_LINE );
  
    LowPowerMode = 1;
  }  
}

/****** (C) 版权2012北京亿旗创新科技发展有限公司 ******文档结束*************/
